## app/boards/shields/breeze_oled/Kconfig.shield
```kconfig
# Copyright (c) 2020 Pete Johanson
# SPDX-License-Identifier: MIT

config SHIELD_BREEZE_OLED_LEFT
	def_bool $(shields_list_contains,breeze_oled_left)

config SHIELD_BREEZE_OLED_RIGHT
	def_bool $(shields_list_contains,breeze_oled_right)
```
